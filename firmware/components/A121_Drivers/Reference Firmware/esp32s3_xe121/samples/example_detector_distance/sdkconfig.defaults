## firmware/components/A121_Drivers/Reference Firmware/esp32s3_xe121/samples/example_detector_distance/sdkconfig.defaults
```kconfig
# Enable Power Management
CONFIG_PM_ENABLE=y

# Set flash size
CONFIG_ESPTOOLPY_FLASHSIZE_16MB=y
CONFIG_ESPTOOLPY_FLASHSIZE="16MB"

CONFIG_IDF_TARGET_ESP32S3=y
CONFIG_IDF_TARGET="esp32s3"

# Set max CPU Frequency for ESP32S3
CONFIG_ESP32S3_DEFAULT_CPU_FREQ_240=y
CONFIG_ESP32S3_DEFAULT_CPU_FREQ_MHZ=240

# Place SPI in IRAM
CONFIG_SPI_MASTER_IN_IRAM=y
CONFIG_SPI_MASTER_ISR_IN_IRAM=y
CONFIG_SPI_SLAVE_ISR_IN_IRAM=y

# UART ISR in IRAM
CONFIG_UART_ISR_IN_IRAM=y

# GPIO Control Function in IRAM
CONFIG_GPIO_CTRL_FUNC_IN_IRAM=y

# Set -O2 compiler option
CONFIG_COMPILER_OPTIMIZATION_PERF=y

# Enable silent assertions
CONFIG_COMPILER_OPTIMIZATION_ASSERTIONS_SILENT=y
```
